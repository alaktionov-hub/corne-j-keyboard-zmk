## boards/shields/nice_view_fly/Kconfig.shield
```kconfig
# Copyright (c) 2026 Anatoliy Laktionov
# SPDX-License-Identifier: MIT

config SHIELD_NICE_VIEW_FLY
    def_bool $(shields_list_contains,nice_view_fly)
```
